#include "main.h"
#include "general.h"
#include "lcd.h"
#include "timers.h"

unsigned char lcd_convertANSITable[256]={
						0x2e,0x2e,0x2e,0x2e,0x2e,0x2e,0x2e,0x2e,0x2e,0x2e,0x2e,0x2e,0x2e,0x2e,0x2e,0x2e,//00
						0x2e,0x2e,0x2e,0x2e,0x2e,0x2e,0x2e,0x2e,0x2e,0x2e,0x2e,0x2e,0x2e,0x2e,0x2e,0x2e,//10
						0x20,0x21,0x22,0x23,0x24,0x25,0x26,0x27,0x28,0x29,0x2a,0x2b,0x2c,0x2d,0x2e,0x2f,//20
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						0x70,0x63,0xbf,0x79,0xe4,0x78,0xe5,0xc0,0xc1,0xe6,0xc2,0xc3,0xc4,0xc5,0xc6,0xc7,//ð-ÿ
					   };

#define lcd_SetLCDPorts DDRD|=0xe0
#define lcd_SetRW PORTD|=0x40
#define lcd_ClearRW PORTD&=0xbf
#define lcd_SetRS PORTD|=0x20
#define lcd_ClearRS PORTD&=0xdf
#define lcd_SetE1 PORTD|=0x80
#define lcd_ClearE1 PORTD&=0x7f
#define lcd_SetE2 PORTD|=0x80
#define lcd_ClearE2 PORTD&=0x7f
#define lcd_DataPortToIn DDRC&=0x00;PORTC&=0x00
#define lcd_DataPortToOut DDRC|=0xff

// rw - âûõîä 1 

void lcd_WaitBuzy(char con);
void lcd_WriteCommand(char b,char con);
void lcd_WriteData(char b,char con);
void lcd_PutData(char b);
char lcd_GetData(void);
void lcd_LedControl();
void lcd_TimeFunc();

unsigned int lcd_time;
#define lcd_timeMax 10

void lcd_WaitBuzy(char con)
{
 char rd=128;
 while ((rd&0x80)>>7)
 {
   asm("wdr");
   lcd_ClearRS;lcd_SetRW;
   if (con==1) {lcd_SetE1;} else {lcd_SetE2;}
   rd=lcd_GetData();
   if (con==1) {lcd_ClearE1;} else {lcd_ClearE2;}
   lcd_ClearRW;lcd_DataPortToIn;
 };
}

void lcd_InitLCD(void)
{
 lcd_time=0;
 lcd_VDDOn;
 lcd_LEDOn;
 lcd_SetLCDPorts;
 lcd_DataPortToIn;
 delay(15);
 lcd_WriteCommand(0x30,1);
 delay(15);
 lcd_WriteCommand(0x30,1);
 delay(15);
 lcd_WriteCommand(0x30,1);
 lcd_WaitBuzy(1);lcd_WriteCommand(0x38,1);
 lcd_WaitBuzy(1);lcd_WriteCommand(0x0c,1);
 lcd_WaitBuzy(1);lcd_WriteCommand(0x06,1);
 lcd_WaitBuzy(1);lcd_WriteCommand(0x01,1);
 timers_RegVirtualTimer(&lcd_TimeFunc);
}

void lcd_PutData(char b)
{
 lcd_DataPortToOut;
 PORTC=b;
}

char lcd_GetData(void)
{
 lcd_DataPortToIn;
 return (PINC);
}

void lcd_WriteCommand(char b,char con)
{
 lcd_ClearRS;lcd_ClearRW;
 if (con==1) {lcd_SetE1;} else {lcd_SetE2;}
 lcd_PutData(b);
 if (con==1) {lcd_ClearE1;} else {lcd_ClearE2;}
 lcd_DataPortToIn;
}

void lcd_WriteData(char b,char con)
{
 lcd_SetRS;lcd_ClearRW;
 if (con==1) {lcd_SetE1;} else {lcd_SetE2;}
 lcd_PutData(b);
 if (con==1) {lcd_ClearE1;} else {lcd_ClearE2;}
 lcd_DataPortToIn;
}

void lcd_PutChar(char pos,char b)
{
 b=lcd_convertANSITable[b];
 if (pos<16) {lcd_WaitBuzy(1);lcd_WriteCommand((pos+128)|0x80,1);lcd_WaitBuzy(1);lcd_WriteData(b,1);}
 else if (pos<32) {lcd_WaitBuzy(1);lcd_WriteCommand((pos+176)|0x80,1);lcd_WaitBuzy(1);lcd_WriteData(b,1);}
       else if (pos<48) {lcd_WaitBuzy(1);lcd_WriteCommand((pos+112)|0x80,1);lcd_WaitBuzy(1);lcd_WriteData(b,1);}
             else {lcd_WaitBuzy(1);lcd_WriteCommand((pos+160)|0x80,1);lcd_WaitBuzy(1);lcd_WriteData(b,1);}
}			

void lcd_ClearLCD(void) {lcd_WriteCommand(1,1);};
void lcd_PutString(char position, char *pString)
{
 char i=0;char s;s=*(pString+i);
 while (s!=0) {lcd_PutChar(position+i,s);i++;s=*(pString+i);}
}

void lcd_PutNum(unsigned char pos,unsigned char num)
{
 char i,i1,i2;
 i=num/100;i1=(num-i*100)/10;i2=num-i*100-i1*10;
 if ((i==0)&&(i1==0)) {lcd_PutChar(pos,' ');lcd_PutChar(pos+1,' ');lcd_PutChar(pos+2,i2+0x30);}
 else if (i==0) {lcd_PutChar(pos,' ');lcd_PutChar(pos+1,i1+0x30);lcd_PutChar(pos+2,i2+0x30);}
 else {lcd_PutChar(pos,i+0x30);lcd_PutChar(pos+1,i1+0x30);lcd_PutChar(pos+2,i2+0x30);}
}

void lcd_PutNumf(unsigned char pos,unsigned char num)
{
 char i,i1,i2;
 i=num/100;i1=(num-i*100)/10;i2=num-i*100-i1*10;
 if (i!=0) {lcd_PutChar(pos,i+0x30);} else {lcd_PutChar(pos,' ');}
 lcd_PutChar(pos+1,i1+0x30);lcd_PutChar(pos+2,',');lcd_PutChar(pos+3,i2+0x30);
}

void lcd_PutNumf2(unsigned char pos,unsigned int num)
{
 unsigned int i0,i,i1,i2;
 i0=num/1000;i=(num-i0*1000)/100;i1=(num-i*100)/10;i2=num-i*100-i1*10;
 if (i0!=0) {lcd_PutChar(pos,i0+0x30);} else {lcd_PutChar(pos,' ');}
 if (i!=0) {lcd_PutChar(pos+1,i+0x30);} else {lcd_PutChar(pos+1,' ');}
 lcd_PutChar(pos+2,i1+0x30);lcd_PutChar(pos+3,',');lcd_PutChar(pos+4,i2+0x30);
}


void lcd_PutNum2(unsigned char pos,unsigned char num)
{
 char i,i1;
 i=num/10;i1=num-i*10;
 if (i!=0) {lcd_PutChar(pos,i+0x30);} else {lcd_PutChar(pos,' ');}
 lcd_PutChar(pos+1,i1+0x30);
}

void lcd_PutNum1(unsigned char pos,unsigned char num)
{
 char i,i1;
 i=num/10;i1=num-i*10;
 lcd_PutChar(pos,i1+0x30);
}

void lcd_TimeFunc()
{
 if (lcd_time==lcd_timeMax) {lcd_VEEOn;}
 if (lcd_time==lcd_timeMax+12) {lcd_VEEOff;lcd_time=0;}
 lcd_time++;
}



